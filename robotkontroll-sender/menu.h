//constructing menu
String menuItems[][3] = {
  {"Robot-Modus", "Instillinger"},
  {"Autonom-Modus", "Taurusmodus", "Manell overstyring"},
  {"Robothastighet", "Lys-styrke", "Kontrast"},
  {"Ingenstillinger"}
};

int muxPin = 8;
int muxOut0 = 19;
int muxOut1 = 18;
int muxOut2 = 17;
int muxOut3 = 16;

int menuPosition = 0;

int subMenuPosition = 0;

void muxToggler(int channel){
  digitalWrite(muxOut0, bitRead(channel, 0));
  digitalWrite(muxOut1, bitRead(channel, 1));
  digitalWrite(muxOut2, bitRead(channel, 2));
  digitalWrite(muxOut3, bitRead(channel, 3));
}

// A button was pushed. Decide what to do!
void buttonPushed(int button){

// if()statement only runs as long as another button
// wasnt pushed less than 200 milliseconds ago.
  if (millis() - _lastButtonPush > 200) {
    _lastButtonPush = millis();

    switch (button) {
    //Left(back button)
    case 0:
    caseZero:
      if(menuPosition != 0)
      menuPosition = 0;
      subMenuPosition = 0;
      break;
      
    //Up
    case 1:
      if (menuPosition == 7){
        
      }
      else if (menuPosition == 8){
        backLightPWM += 10;
        setBl();
        break;
      }
      else if (menuPosition == 9){
        screenContrast += 10;
        setContrast();
        break;
      }
      else{
      if(subMenuPosition != 0)
        subMenuPosition--;
      else
        subMenuPosition = 2;
      }
      break;
      
    //Right(Choosebutton)
    //Holds quite a lot of logic.
    case 2:
      //HovedMeny
      caseTwo: //goto label for the choose button
      if(menuPosition == 0){
          if(subMenuPosition == 0){
            //RobotModus
            menuPosition = 1;
            subMenuPosition = 0;
            break;
          }
          if(subMenuPosition == 1){
            //Instillinger
            menuPosition = 2;
            subMenuPosition = 0;
            break;
          }
          if(subMenuPosition == 2){
            //Melodier
            menuPosition = 3;
            subMenuPosition = 0;
            break;
          }
      }
   
      //RobotModusMeny
      if(menuPosition == 1){
          if(subMenuPosition == 0){
            //Autunom
            robotStateLocal = 0;
            menuPosition = 0;
          }
          if(subMenuPosition == 1){
            //Taurus
            robotStateLocal = 1;
            menuPosition = 0;
            subMenuPosition = 0;

          }
          if(subMenuPosition == 2){
            //Manuell
            robotStateLocal = 2;
            menuPosition = 0;
            subMenuPosition = 0;
          }

     
      }
      //Instillinger
      if(menuPosition == 2){
        if(subMenuPosition == 0){
            //Fart
            //menuPosition = 7;
            //subMenuPosition = 0;   
        }
        if(subMenuPosition == 1){
          //Lys-styrke
            menuPosition = 8;
            subMenuPosition = 0;            
        }
        if(subMenuPosition == 2){
            //Kontrast
            menuPosition = 9;
            subMenuPosition = 0;
        }

      }
      //Not in use
      if(menuPosition == 3){}
      break;

    //Down
    case 3:
          if (menuPosition == 7){
        
      }
      else if (menuPosition == 8){
        backLightPWM -= 10;
        setBl();

      }
      else if (menuPosition == 9){
        screenContrast -= 10;
        setContrast();
      }
      else {
      if(subMenuPosition <= 2)
      subMenuPosition++;
      if(subMenuPosition == 3)
      subMenuPosition = 0;
      }
      break;
    //Back button, defined in case 0
    case 4:
      goto caseZero;
      break;

    //Choose button, defined in case 2
    case 5:
    goto caseTwo;
      break;

      
    //The rest of these are the rest of the ports
    // on the 16 pin multiplexer.
    // Ready for new logic to send to the robot...
    case 6:
      break;
    case 7:
      break;
    case 8:
      break;
    case 9:
      break;
    case 10:
      break;
    case 11:
      break;
    case 12:
      break;
    case 13:
      break;
    case 14:
      break;
    case 15:
      break;      
  }
  }
  
}

void buttonChecker(){
  Serial.println("Push button at channel: ");
    for (int i = 0; i < 16; i++) {
        muxToggler(i);
        byte data = digitalRead(muxPin);
        if(data == LOW){
          buttonPushed(i);
          Serial.print(i);
        }
  }
}



// Displaying menu

void updateMenu(){
  display.clearDisplay();
  display.setTextSize(1);
  display.setCursor(0,0);
  //display.write("robotState->");
  //display.println(robotStateLocal);
  display.println("-MENU-"); 
  display.setTextSize(0);
  if(menuPosition == 8){
    display.write("Lys-styrke: ");
    display.println(backLightPWM);
    display.println("opp og ned for å justere");
  }
  else if(menuPosition == 9){
    display.write("Skjermkontrast: ");
    display.println(screenContrast);
    display.println("opp og ned for å justere");
  }
  else {
    
    if (menuPosition != 0 && 7 && 8 && 9){
      display.write("--");
      String text = menuItems[0][menuPosition-1];
      display.println(text);
    }

    for (int i = 0; i < 3; i++){
      if (i == subMenuPosition){
          display.setTextColor(WHITE, BLACK); // 'inverted' text
          display.println(menuItems[menuPosition][i]);
          display.setTextColor(BLACK, WHITE);
      }
      else display.println(menuItems[menuPosition][i]);
    }

    if (menuPosition == 0){
      display.drawRoundRect(0, 24, 82, 24, 0, BLACK);
      display.setCursor(2,26);
      if (robotConnected == 0){
            display.println("Frakoblet.");
      }
      else {
        if (robotStateLocal == 0){
          display.println("Auto-modus");
        }
        if (robotStateLocal == 1){
          display.println("Taurus-modus");
        }
        if (robotStateLocal == 2){
          display.println("Manuell-modus");
        }
        
        display.setCursor(2, 36); 
      
      }

    }
    
  }
  display.display();
}
const uint8_t pixilframe0_Width    = 84;
const uint8_t pixilframe0_Height   = 48;
const uint8_t PROGMEM pixilframe0_Bitmap[] = {    
// 'pixil-frame-0(1)', 84x48px
0x00, 0x00, 0x00, 0x00, 0x00, 0x00, 0x00, 0x00, 0x00, 0x00, 0x00, 0x00, 0x00, 0x00, 0x00, 0x00, 
0x00, 0x00, 0x00, 0x00, 0x00, 0x00, 0x00, 0x00, 0x00, 0x00, 0x00, 0x00, 0x00, 0x06, 0x00, 0x00, 
0x00, 0x00, 0x00, 0x03, 0x80, 0x00, 0xff, 0xfe, 0x3f, 0xc0, 0x00, 0x00, 0x07, 0xe0, 0x03, 0x80, 
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0x30, 0x00, 0x00, 0x00, 0x00, 0x00, 0x00, 0x00, 0x00, 0x80, 0x00, 0x20, 0x00, 0x00, 0x00, 0x00
};
